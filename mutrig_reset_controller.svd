# MU3E_MUTRIG_RESET_CONTROLLER register map
Vendor: Mu3e; Series: MU3E_FPGA_IP; File version: 1.0.8
MuTRiG reset controller management aperture. The current RTL exposes the reconfig_mgmt Avalon-MM port as the 64-word PLL-reconfiguration window; in the active source the PLL reconfiguration sub-IP is disabled, so this SVD intentionally models the window as raw implementation-defined words.
Registers are 32-bit, read-write, reset 0x0 unless marked. A register's access mark holds for its fields unless they carry their own. Offsets are from the block's base; lines under a group give offsets from that group; [hi:lo] are bit positions; {n}, {i} and the like mark numbered series; 'fields as' and 'values as' point back to an identical list; <NAME> marks a mode.

## Memory map
0x00000000 MUTRIG_RESET_RECONFIG_MGMT size 0x100 — Relative 64-word raw management aperture.

## MUTRIG_RESET_RECONFIG_MGMT — Relative 64-word raw management aperture.
Base 0x00000000
{0x0+4i} RAW_WORD{i} (i=0..63) — Raw reconfiguration word. Readback is implementation-defined in this build.
  [31:0] value — Raw 32-bit management value.
